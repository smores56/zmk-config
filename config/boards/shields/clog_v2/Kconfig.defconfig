## config/boards/shields/clog_v2/Kconfig.defconfig
```kconfig
# Copyright (c) 2022 The ZMK Contributors
# SPDX-License-Identifier: MIT

if SHIELD_CLOG_V2_LEFT

config ZMK_KEYBOARD_NAME
    default "Clog V2"
    
config ZMK_SPLIT_ROLE_CENTRAL
    default y

endif

if SHIELD_CLOG_V2

config ZMK_SPLIT
    default y

endif
```

## config/boards/shields/clog_v2/Kconfig.shield
```kconfig
# Copyright (c) 2022 The ZMK Contributors
# SPDX-License-Identifier: MIT

config SHIELD_CLOG_V2
    bool

config SHIELD_CLOG_V2_LEFT
    def_bool $(shields_list_contains,clog_v2_left)
    select SHIELD_CLOG_V2

config SHIELD_CLOG_V2_RIGHT
    def_bool $(shields_list_contains,clog_v2_right)
    select SHIELD_CLOG_V2
```

## config/boards/shields/geta/Kconfig.defconfig
```kconfig
# Copyright (c) 2022 The ZMK Contributors
# SPDX-License-Identifier: MIT

if SHIELD_GETA_LEFT

config ZMK_KEYBOARD_NAME
    default "Geta"
    
config ZMK_SPLIT_ROLE_CENTRAL
    default y

endif

if SHIELD_GETA

config ZMK_SPLIT
    default y

endif
```

## config/boards/shields/geta/Kconfig.shield
```kconfig
# Copyright (c) 2022 The ZMK Contributors
# SPDX-License-Identifier: MIT

config SHIELD_GETA
    bool

config SHIELD_GETA_LEFT
    def_bool $(shields_list_contains,geta_left)
    select SHIELD_GETA

config SHIELD_GETA_RIGHT
    def_bool $(shields_list_contains,geta_right)
    select SHIELD_GETA
```

## config/boards/shields/the_moon/Kconfig.shield
```kconfig
# Copyright (c) 2022 The ZMK Contributors
# SPDX-License-Identifier: MIT

config SHIELD_THE_MOON
   def_bool $(shields_list_contains,the_moon)
```

## config/boards/shields/the_paintbrush/Kconfig.defconfig
```kconfig
if SHIELD_THE_PAINTBRUSH_LEFT || SHIELD_THE_PAINTBRUSH_RIGHT

config ZMK_KEYBOARD_NAME
	default "The Paintbrush"

endif
```

## config/boards/shields/xiao_settings_reset/Kconfig.defconfig
```kconfig
# Copyright (c) 2020 The ZMK Contributors
# SPDX-License-Identifier: MIT

if SHIELD_XIAO_SETTINGS_RESET

config ZMK_KEYBOARD_NAME
	default "SETTINGS RESET"

endif
```

## config/boards/shields/xiao_settings_reset/Kconfig.shield
```kconfig
# Copyright (c) 2020 The ZMK Contributors
# SPDX-License-Identifier: MIT

config SHIELD_XIAO_SETTINGS_RESET
	def_bool $(shields_list_contains,xiao_settings_reset)
```

## config/west.yml
```yaml
manifest:
  remotes:
    - name: petejohanson
      url-base: https://github.com/petejohanson
  projects:
    - name: zmk
      remote: petejohanson
      revision: hardware/rp2040-support
      import: app/west.yml
  self:
    path: config
```
